## conf/layer.conf
```bitbake
# We have a conf and classes directory, add to BBPATH
BBPATH .= ":${LAYERDIR}:${LAYERDIR}/meta-retro"

# We have recipes-* directories, add to BBFILES
BBFILES += "${LAYERDIR}/recipes-*/*/*.bb \
            ${LAYERDIR}/recipes-*/*/*.bbappend \
            ${LAYERDIR}/meta-retro/recipes-*/*/*.bb \
            ${LAYERDIR}/meta-retro/recipes-*/*/*.bbappend \
            ${LAYERDIR}/meta-retro/recipes*/*/*/*.bb \
            ${LAYERDIR}/meta-retro/recipes*/*/*/*.bbappend"

BBFILE_COLLECTIONS += "meta-retroarch"
BBFILE_PATTERN_meta-retroarch = "^${LAYERDIR}/"
BBFILE_PRIORITY_meta-retroarch = "6"

LAYERDEPENDS_meta-retroarch = "core"
LAYERSERIES_COMPAT_meta-retroarch = "kirkstone"

LAYERDEPENDS_meta-retroarch = " \
    core \
    multimedia-layer \
    networking-layer \
    openembedded-layer \
"

BBMASK += "meta-retro/recipes-qt/ \
          meta-retro/recipes-emulation/dolphin-emu \
          "
```
